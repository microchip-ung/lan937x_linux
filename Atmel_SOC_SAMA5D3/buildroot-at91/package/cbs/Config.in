## src/kernels/masternet-next/Documentation/devicetree/bindings/net/dsa/lan937x.yaml
```yaml
# SPDX-License-Identifier: (GPL-2.0-only OR BSD-2-Clause)
%YAML 1.2
---
$id: http://devicetree.org/schemas/net/dsa/lan937x.yaml#
$schema: http://devicetree.org/meta-schemas/core.yaml#

title: LAN937x Ethernet Switch Series Tree Bindings

maintainers:
  - prasanna.vengateshan@microchip.com

properties:
  compatible:
    oneOf:
      - const: "microchip,lan9370"
      - const: "microchip,lan9371"
      - const: "microchip,lan9372"
      - const: "microchip,lan9373"
      - const: "microchip,lan9374"

  reset-gpios:
    description: should be a gpio specifier for a reset line

  microchip,synclko-125:
    description: Set if the output SYNCLKO frequency should be set to
      125MHz instead of 25MHz.
    type: boolean

required:
  - compatible

example:
  Ethernet switch connected via SPI to the host, CPU port wired to eth1:

	eth1: ethernet@f802c000 {
		#address-cells = <1>;
		#size-cells = <0>;

		fixed-link {
			speed = <100>;
			full-duplex;
		};
	};

	spi1: spi@f8008000 {
		cs-gpios = <0>, <0>, <0>, <&pioC 28 0>;
		id = <1>;

		lan9370: lan9370@3 {
			compatible = "microchip,lan9370";
			reg = <3>;

			spi-max-frequency = <44000000>;
			spi-cpha;
			spi-cpol;

			ports {
				#address-cells = <1>;
				#size-cells = <0>;
				port@0 {
					reg = <0>;
					label = "lan1";
				};
				port@1 {
					reg = <1>;
					label = "lan2";
				};
				port@2 {
					reg = <2>;
					label = "lan3";
				};
				port@3 {
					reg = <3>;
					label = "lan4";
				};
				port@4 {
					reg = <4>;
					label = "cpu";
          ethernet = <&eth1>;
          phy-mode = "rmii";
					fixed-link {
						speed = <100>;
						full-duplex;
					};
				};
			};
		};

		lan9371: lan9371@3 {
			compatible = "microchip,lan9371";
			reg = <3>;

			spi-max-frequency = <44000000>;
			spi-cpha;
			spi-cpol;

			ports {
				#address-cells = <1>;
				#size-cells = <0>;
				port@0 {
					reg = <0>;
					label = "lan1";
				};
				port@1 {
					reg = <1>;
					label = "lan2";
				};
				port@2 {
					reg = <2>;
					label = "lan3";
				};
				port@3 {
					reg = <3>;
					label = "lan4";
				};
				port@4 {
					reg = <4>;
					label = "cpu";
          ethernet = <&eth1>;
          phy-mode = "rmii";
					fixed-link {
						speed = <100>;
						full-duplex;
					};
				};
				port@5 {
					reg = <5>;
          label = "lan5";
          phy-mode = "rmii";
					fixed-link {
						speed = <100>;
						full-duplex;
					};
				};
			};
		};
	};
```

## src/kernels/masternet-next/Documentation/devicetree/bindings/net/dsa/microchip,lan937x.yaml
```yaml
# SPDX-License-Identifier: (GPL-2.0-only OR BSD-2-Clause)
%YAML 1.2
---
$id: http://devicetree.org/schemas/net/dsa/microchip,lan937x.yaml#
$schema: http://devicetree.org/meta-schemas/core.yaml#

title: LAN937x Ethernet Switch Series Tree Bindings

maintainers:
  - woojung.huh@microchip.com
  - prasanna.vengateshan@microchip.com

allOf:
  - $ref: dsa.yaml#

properties:
  compatible:
    enum:
      - microchip,lan9370
      - microchip,lan9371
      - microchip,lan9372
      - microchip,lan9373
      - microchip,lan9374

  ethernet-ports:
    type: object
    properties:
      '#address-cells':
        const: 1
      '#size-cells':
        const: 0

  reg:
    maxItems: 1

  spi-max-frequency: true

  reset-gpios:
    description: should be a gpio specifier for a reset line

required:
  - compatible
  - reg

unevaluatedProperties: false

examples:
  - |
    #include <dt-bindings/gpio/gpio.h>

    //Ethernet switch connected via spi to the host, CPU port wired to eth1
    eth1 {
      #address-cells = <1>;
      #size-cells = <0>;

      fixed-link {
        speed = <100>;
        full-duplex;
      };
    };

    spi1 {
      #address-cells = <1>;
      #size-cells = <0>;
      pinctrl-0 = <&pinctrl_spi_ksz>;
      cs-gpios = <0>, <0>, <0>, <&pioC 28 0>;
      id = <1>;

      lan9374: switch@0 {
        compatible = "microchip,lan9374";
        reg = <0>;

        spi-max-frequency = <44000000>;

        ethernet-ports {
          #address-cells = <1>;
          #size-cells = <0>;
          port@0 {
            reg = <0>;
            label = "lan1";
          };
          port@1 {
            reg = <1>;
            label = "lan2";
          };
          port@2 {
            reg = <7>;
            label = "lan3";
          };
          port@3 {
            reg = <2>;
            label = "lan4";
          };
          port@4 {
            reg = <6>;
            label = "lan5";
          };
          port@5 {
            reg = <3>;
            label = "lan6";
          };
          port@6 {
            reg = <4>;
            label = "cpu";
            ethernet = <&eth1>;
            phy-mode = "rmii";
            fixed-link {
              speed = <100>;
              full-duplex;
            };
          };
          port@7 {
            reg = <5>;
            phy-mode = "rmii";
            label = "lan7";
            fixed-link {
              speed = <100>;
              full-duplex;
            };
          };
        };
      };
    };
```

## src/kernels/masternet-next/drivers/net/dsa/microchip/Kconfig
```kconfig
# SPDX-License-Identifier: GPL-2.0-only
config NET_DSA_MICROCHIP_KSZ_COMMON
	select NET_DSA_TAG_KSZ
	tristate

config NET_DSA_MICROCHIP_LAN937X
	tristate "Microchip LAN937X series SPI connected switch support"
	depends on NET_DSA && SPI
	select NET_DSA_MICROCHIP_KSZ_COMMON
	select REGMAP_SPI
	help
	  This driver adds support for Microchip LAN937X series
	  switch chips.

	  Select to enable support for registering switches configured
	  through SPI.

config NET_DSA_MICROCHIP_LAN937X_PTP
	bool "Support for the PTP clock on the LAN937x Ethernet Switch"
	depends on NET_DSA_MICROCHIP_LAN937X
	depends on PTP_1588_CLOCK
	help
		This enables support for timestamping & PTP clock manipulation in the 
		LAN937x Ethernet switch

config NET_DSA_MICROCHIP_LAN937X_TAS
	bool "Support for the Time-Aware Scheduler on LAN937x Ethernet Switch"
	depends on NET_DSA_MICROCHIP_LAN937X && NET_SCH_TAPRIO
	depends on NET_SCH_TAPRIO=y || NET_DSA_MICROCHIP_LAN937X=m
	depends on NET_DSA_MICROCHIP_LAN937X_PTP
	help
	  This enables support for the Time aware scheduler in LAN937x DSA
	  Driver, which is controlled using a hardware offload of the
	  tc-tqprio qdisc.

menuconfig NET_DSA_MICROCHIP_KSZ9477
	tristate "Microchip KSZ9477 series switch support"
	depends on NET_DSA
	select NET_DSA_MICROCHIP_KSZ_COMMON
	help
	  This driver adds support for Microchip KSZ9477 switch chips.

config NET_DSA_MICROCHIP_KSZ9477_I2C
	tristate "KSZ9477 series I2C connected switch driver"
	depends on NET_DSA_MICROCHIP_KSZ9477 && I2C
	select REGMAP_I2C
	help
	  Select to enable support for registering switches configured through I2C.

config NET_DSA_MICROCHIP_KSZ9477_SPI
	tristate "KSZ9477 series SPI connected switch driver"
	depends on NET_DSA_MICROCHIP_KSZ9477 && SPI
	select REGMAP_SPI
	help
	  Select to enable support for registering switches configured through SPI.

menuconfig NET_DSA_MICROCHIP_KSZ8795
	tristate "Microchip KSZ8795 series switch support"
	depends on NET_DSA
	select NET_DSA_MICROCHIP_KSZ_COMMON
	help
	  This driver adds support for Microchip KSZ8795/KSZ88X3 switch chips.

config NET_DSA_MICROCHIP_KSZ8795_SPI
	tristate "KSZ8795 series SPI connected switch driver"
	depends on NET_DSA_MICROCHIP_KSZ8795 && SPI
	select REGMAP_SPI
	help
	  This driver accesses KSZ8795 chip through SPI.

	  It is required to use the KSZ8795 switch driver as the only access
	  is through SPI.

config NET_DSA_MICROCHIP_KSZ8863_SMI
	tristate "KSZ series SMI connected switch driver"
	depends on NET_DSA_MICROCHIP_KSZ8795
	select MDIO_BITBANG
	help
	  Select to enable support for registering switches configured through
	  Microchip SMI. It supports the KSZ8863 and KSZ8873 switch.
```
