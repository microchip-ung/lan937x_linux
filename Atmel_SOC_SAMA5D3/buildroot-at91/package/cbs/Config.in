## Atmel_SOC_SAMA5D3/buildroot-at91/package/cbs/Config.in
```kconfig
config BR2_PACKAGE_CBS
    bool "cbs"
    help
        Hello world package.

        http://example.com
```

## src/Atmel_SOC_SAMA5D3/buildroot-at91/configs/atmel_sama5d3_xplained_lan937x_defconfig
```kconfig
BR2_arm=y
BR2_cortex_a5=y
BR2_ARM_ENABLE_VFP=y
BR2_ARM_INSTRUCTIONS_THUMB2=y
BR2_DL_DIR="../dl"
BR2_TOOLCHAIN_EXTERNAL=y
BR2_TOOLCHAIN_EXTERNAL_LINARO_ARM=y
BR2_ROOTFS_OVERLAY="board/atmel/sama5d3_xplained_ksz9897/rootfs_overlay"
BR2_ROOTFS_POST_BUILD_SCRIPT="board/atmel/sama5d3_xplained_ksz9897/post-build.sh"
BR2_ROOTFS_POST_IMAGE_SCRIPT="board/atmel/sama5d3_xplained_ksz9897/post-image.sh"
BR2_LINUX_KERNEL=y
BR2_LINUX_KERNEL_USE_CUSTOM_CONFIG=y
BR2_LINUX_KERNEL_CUSTOM_CONFIG_FILE="$(SRC_HOME)/kernels/masternet-next/arch/arm/configs/sama5_lan937x_dsa_defconfig"
BR2_LINUX_KERNEL_DTS_SUPPORT=y
BR2_LINUX_KERNEL_CUSTOM_DTS_PATH="$(SRC_HOME)/Atmel_SOC_SAMA5D3/dts/at91-sama5d3_xplained_lan937x.dts"
BR2_PACKAGE_BUSYBOX_CONFIG="board/atmel/sama5d3_xplained_ksz9897/busybox.config"
BR2_PACKAGE_E2FSPROGS=y
BR2_PACKAGE_UBOOT_TOOLS=y
BR2_PACKAGE_LIBMNL=y
BR2_PACKAGE_BRIDGE_UTILS=y
BR2_PACKAGE_ETHTOOL=y
BR2_PACKAGE_IPERF3=y
BR2_PACKAGE_IPROUTE2=y
BR2_PACKAGE_LINUXPTP=y
BR2_PACKAGE_MII_DIAG=y
BR2_PACKAGE_NUTTCP=y
BR2_PACKAGE_TCPDUMP=y
BR2_PACKAGE_LAN937x_TC=y
BR2_TARGET_ROOTFS_UBI=y
BR2_TARGET_ROOTFS_UBI_SUBSIZE=2048
BR2_TARGET_ROOTFS_UBIFS_LEBSIZE=0x1f000
BR2_TARGET_AT91BOOTSTRAP3=y
BR2_TARGET_AT91BOOTSTRAP3_CUSTOM_GIT=y
BR2_TARGET_AT91BOOTSTRAP3_CUSTOM_REPO_URL="https://github.com/linux4sam/at91bootstrap.git"
BR2_TARGET_AT91BOOTSTRAP3_CUSTOM_REPO_VERSION="v4.0.0"
BR2_TARGET_AT91BOOTSTRAP3_DEFCONFIG="sama5d3_xplainednf_uboot"
BR2_TARGET_UBOOT=y
BR2_TARGET_UBOOT_BUILD_SYSTEM_KCONFIG=y
BR2_TARGET_UBOOT_CUSTOM_GIT=y
BR2_TARGET_UBOOT_CUSTOM_REPO_URL="https://github.com/linux4sam/u-boot-at91.git"
BR2_TARGET_UBOOT_CUSTOM_REPO_VERSION="linux4sam-2021.04"
BR2_TARGET_UBOOT_PATCH="../patches/uboot-linux4sam-2021.04"
BR2_TARGET_UBOOT_BOARD_DEFCONFIG="sama5d3_xplained_lan937x_nandflash"
BR2_PACKAGE_HOST_SAM_BA=y
```

## src/Atmel_SOC_SAMA5D3/buildroot-at91/configs/atmel_sama5d3_xplained_lan937x_mmc_defconfig
```kconfig
BR2_arm=y
BR2_cortex_a5=y
BR2_ARM_ENABLE_VFP=y
BR2_ARM_INSTRUCTIONS_THUMB2=y
BR2_DL_DIR="../dl"
BR2_TOOLCHAIN_EXTERNAL=y
BR2_TOOLCHAIN_EXTERNAL_LINARO_ARM=y
BR2_ROOTFS_OVERLAY="board/atmel/sama5d3_xplained_ksz9897/rootfs_overlay"
BR2_ROOTFS_POST_BUILD_SCRIPT="board/atmel/sama5d3_xplained_ksz9897/post-build.sh"
BR2_ROOTFS_POST_IMAGE_SCRIPT="board/atmel/sama5d3_xplained_ksz9897/post-mmc-image.sh"
BR2_LINUX_KERNEL=y
BR2_LINUX_KERNEL_USE_CUSTOM_CONFIG=y
BR2_LINUX_KERNEL_CUSTOM_CONFIG_FILE="$(SRC_HOME)/kernels/masternet-next/arch/arm/configs/sama5_lan937x_dsa_defconfig"
BR2_LINUX_KERNEL_DTS_SUPPORT=y
BR2_LINUX_KERNEL_CUSTOM_DTS_PATH="$(SRC_HOME)/Atmel_SOC_SAMA5D3/dts/at91-sama5d3_xplained_lan937x.dts"
BR2_PACKAGE_BUSYBOX_CONFIG="board/atmel/sama5d3_xplained_ksz9897/busybox.config"
BR2_PACKAGE_E2FSPROGS=y
BR2_PACKAGE_UBOOT_TOOLS=y
BR2_PACKAGE_BRIDGE_UTILS=y
BR2_PACKAGE_ETHTOOL=y
BR2_PACKAGE_IPERF3=y
BR2_PACKAGE_IPROUTE2=y
BR2_PACKAGE_LINUXPTP=y
BR2_PACKAGE_NUTTCP=y
BR2_PACKAGE_TCPDUMP=y
BR2_TARGET_ROOTFS_EXT2=y
BR2_TARGET_ROOTFS_EXT2_4=y
BR2_TARGET_ROOTFS_EXT2_SIZE="120M"
BR2_TARGET_AT91BOOTSTRAP3=y
BR2_TARGET_AT91BOOTSTRAP3_CUSTOM_TARBALL=y
BR2_TARGET_AT91BOOTSTRAP3_CUSTOM_TARBALL_LOCATION="$(call github,linux4sam,at91bootstrap,v3.9.0)/at91bootstrap3-v3.9.0.tar.gz"
BR2_TARGET_AT91BOOTSTRAP3_DEFCONFIG="sama5d3_xplainedsd_uboot"
BR2_TARGET_UBOOT=y
BR2_TARGET_UBOOT_BUILD_SYSTEM_KCONFIG=y
BR2_TARGET_UBOOT_CUSTOM_GIT=y
BR2_TARGET_UBOOT_CUSTOM_REPO_URL="https://github.com/linux4sam/u-boot-at91.git"
BR2_TARGET_UBOOT_CUSTOM_REPO_VERSION="linux4sam-2021.04"
BR2_TARGET_UBOOT_PATCH="../patches/uboot-linux4sam-2021.04"
BR2_TARGET_UBOOT_BOARD_DEFCONFIG="sama5d3_xplained_lan937x_mmc"
BR2_TARGET_UBOOT_ENVIMAGE=y
BR2_TARGET_UBOOT_ENVIMAGE_SOURCE="board/atmel/sama5d3_xplained_ksz9897/uboot-env.txt"
BR2_TARGET_UBOOT_ENVIMAGE_SIZE="0x4000"
BR2_PACKAGE_HOST_DOSFSTOOLS=y
BR2_PACKAGE_HOST_GENIMAGE=y
BR2_PACKAGE_HOST_MTOOLS=y
```

## src/Atmel_SOC_SAMA5D3/buildroot-at91/package/custom-scripts/Config.in
```kconfig
config BR2_PACKAGE_CUSTOM_SCRIPTS
	bool "custom-scripts"
	default "y"
	help
	  import custom test scripts to target directory
```

## src/Atmel_SOC_SAMA5D3/buildroot-at91/package/microchip/lan937x_tc/Config.in
```kconfig
config BR2_PACKAGE_LAN937x_TC
    bool "lan937x_tc"
    help
        It contains the tsn talker and listener source file
```

## src/Atmel_SOC_SAMA5D3/buildroot_external_lan937x/Config.in
```kconfig
source "$BR2_EXTERNAL_LAN937x_PATH/package/lan937x_tc/Config.in"
source "$BR2_EXTERNAL_LAN937x_PATH/package/dt-overlay-mchp/Config.in"
```

## src/Atmel_SOC_SAMA5D3/buildroot_external_lan937x/configs/atmel_sama5d3_xplained_lan937x_defconfig
```kconfig
BR2_arm=y
BR2_cortex_a5=y
BR2_ARM_ENABLE_VFP=y
BR2_ARM_INSTRUCTIONS_THUMB2=y
BR2_DL_DIR="../dl"
BR2_PACKAGE_OVERRIDE_FILE="$(BR2_EXTERNAL_LAN937x_PATH)/local.mk"
BR2_TOOLCHAIN_EXTERNAL=y
BR2_ROOTFS_OVERLAY="$(BR2_EXTERNAL_LAN937x_PATH)/board/atmel/sama5d3_xplained_lan937x/rootfs_overlay"
BR2_ROOTFS_POST_BUILD_SCRIPT="$(BR2_EXTERNAL_LAN937x_PATH)/board/atmel/sama5d3_xplained_lan937x/post-build.sh"
BR2_ROOTFS_POST_IMAGE_SCRIPT="$(BR2_EXTERNAL_LAN937x_PATH)/board/atmel/sama5d3_xplained_lan937x/post-image.sh"
BR2_LINUX_KERNEL=y
BR2_LINUX_KERNEL_CUSTOM_VERSION=y
BR2_LINUX_KERNEL_CUSTOM_VERSION_VALUE="6.0-rc4"
BR2_LINUX_KERNEL_VERSION="6.0-rc4"
BR2_LINUX_KERNEL_PATCH="$(BR2_EXTERNAL_LAN937x_PATH)/board/atmel/sama5d3_xplained_lan937x/patches/linux/6.0-rc4"
BR2_LINUX_KERNEL_USE_CUSTOM_CONFIG=y
BR2_LINUX_KERNEL_CUSTOM_CONFIG_FILE="$(BR2_EXTERNAL_LAN937x_PATH)/board/atmel/sama5d3_xplained_lan937x/sama5_lan937x_dsa_defconfig"
BR2_LINUX_KERNEL_DTS_SUPPORT=y
BR2_LINUX_KERNEL_CUSTOM_DTS_PATH="$(SRC_HOME)/Atmel_SOC_SAMA5D3/dts/at91-sama5d3_eds.dts"
BR2_PACKAGE_BUSYBOX_CONFIG="$(BR2_EXTERNAL_LAN937x_PATH)/board/atmel/sama5d3_xplained_lan937x/busybox.config"
BR2_LINUX_KERNEL_DTB_OVERLAY_SUPPORT=y
BR2_PACKAGE_STRACE=y
BR2_PACKAGE_DOSFSTOOLS=y
BR2_PACKAGE_DOSFSTOOLS_FSCK_FAT=y
BR2_PACKAGE_E2FSPROGS=y
BR2_PACKAGE_UBOOT_TOOLS=y
BR2_PACKAGE_LIBMNL=y
BR2_PACKAGE_BRIDGE_UTILS=y
BR2_PACKAGE_DROPBEAR=y
BR2_PACKAGE_ETHTOOL=y
BR2_PACKAGE_IPERF3=y
BR2_PACKAGE_IPROUTE2=y
BR2_PACKAGE_LINUXPTP=y
BR2_PACKAGE_MII_DIAG=y
BR2_PACKAGE_NUTTCP=y
BR2_PACKAGE_TCPDUMP=y
BR2_TARGET_ROOTFS_UBI=y
BR2_TARGET_ROOTFS_UBI_SUBSIZE=2048
BR2_TARGET_ROOTFS_UBIFS_LEBSIZE=0x1f000
BR2_TARGET_AT91BOOTSTRAP3=y
BR2_TARGET_AT91BOOTSTRAP3_CUSTOM_GIT=y
BR2_TARGET_AT91BOOTSTRAP3_CUSTOM_REPO_URL="https://github.com/linux4sam/at91bootstrap.git"
BR2_TARGET_AT91BOOTSTRAP3_CUSTOM_REPO_VERSION="v4.0.0"
BR2_TARGET_AT91BOOTSTRAP3_DEFCONFIG="sama5d3_xplainednf_uboot"
BR2_TARGET_UBOOT=y
BR2_TARGET_UBOOT_BUILD_SYSTEM_KCONFIG=y
BR2_TARGET_UBOOT_CUSTOM_GIT=y
BR2_TARGET_UBOOT_CUSTOM_REPO_URL="https://github.com/linux4sam/u-boot-at91.git"
BR2_TARGET_UBOOT_CUSTOM_REPO_VERSION="linux4sam-2021.04"
BR2_TARGET_UBOOT_PATCH="../patches/uboot-linux4sam-2021.04"
BR2_TARGET_UBOOT_BOARD_DEFCONFIG="sama5d3_xplained_lan937x_nandflash"
BR2_PACKAGE_HOST_SAM_BA=y
BR2_PACKAGE_DT_OVERLAY_MCHP=y
BR2_PACKAGE_DT_OVERLAY_MCHP_PLATFORM="sama5d3_eds"
BR2_PACKAGE_DT_OVERLAY_MCHP_FIT=y
```

## src/Atmel_SOC_SAMA5D3/buildroot_external_lan937x/configs/atmel_sama5d3_xplained_lan937x_mmc_defconfig
```kconfig
BR2_arm=y
BR2_cortex_a5=y
BR2_ARM_ENABLE_VFP=y
BR2_ARM_INSTRUCTIONS_THUMB2=y
BR2_DL_DIR="../dl"
BR2_TOOLCHAIN_EXTERNAL=y
BR2_ROOTFS_OVERLAY="board/atmel/sama5d3_xplained_lan937x/rootfs_overlay"
BR2_ROOTFS_POST_BUILD_SCRIPT="board/atmel/sama5d3_xplained_lan937x/post-build.sh"
BR2_ROOTFS_POST_IMAGE_SCRIPT="board/atmel/sama5d3_xplained_lan937x/post-mmc-image.sh"
BR2_LINUX_KERNEL=y
BR2_LINUX_KERNEL_USE_CUSTOM_CONFIG=y
BR2_LINUX_KERNEL_CUSTOM_CONFIG_FILE="board/atmel/sama5d3_xplained_lan937x/sama5_lan937x_dsa_defconfig"
BR2_LINUX_KERNEL_DTS_SUPPORT=y
BR2_LINUX_KERNEL_CUSTOM_DTS_PATH="$(SRC_HOME)/Atmel_SOC_SAMA5D3/dts/at91-sama5d3_xplained_lan937x.dts"
BR2_PACKAGE_BUSYBOX_CONFIG="board/atmel/sama5d3_xplained_lan937x/busybox.config"
BR2_PACKAGE_DOSFSTOOLS=y
BR2_PACKAGE_DOSFSTOOLS_FSCK_FAT=y
BR2_PACKAGE_E2FSPROGS=y
BR2_PACKAGE_UBOOT_TOOLS=y
BR2_PACKAGE_LIBMNL=y
BR2_PACKAGE_BRIDGE_UTILS=y
BR2_PACKAGE_ETHTOOL=y
BR2_PACKAGE_IPERF3=y
BR2_PACKAGE_IPROUTE2=y
BR2_PACKAGE_LINUXPTP=y
BR2_PACKAGE_NUTTCP=y
BR2_PACKAGE_TCPDUMP=y
BR2_TARGET_ROOTFS_EXT2=y
BR2_TARGET_ROOTFS_EXT2_4=y
BR2_TARGET_ROOTFS_EXT2_SIZE="80M"
BR2_TARGET_AT91BOOTSTRAP3=y
BR2_TARGET_AT91BOOTSTRAP3_CUSTOM_GIT=y
BR2_TARGET_AT91BOOTSTRAP3_CUSTOM_REPO_URL="https://github.com/linux4sam/at91bootstrap.git"
BR2_TARGET_AT91BOOTSTRAP3_CUSTOM_REPO_VERSION="v4.0.0"
BR2_TARGET_AT91BOOTSTRAP3_DEFCONFIG="sama5d3_xplainedsd_uboot"
BR2_TARGET_UBOOT=y
BR2_TARGET_UBOOT_BUILD_SYSTEM_KCONFIG=y
BR2_TARGET_UBOOT_CUSTOM_GIT=y
BR2_TARGET_UBOOT_CUSTOM_REPO_URL="https://github.com/linux4sam/u-boot-at91.git"
BR2_TARGET_UBOOT_CUSTOM_REPO_VERSION="linux4sam-2021.04"
BR2_TARGET_UBOOT_PATCH="../patches/uboot-linux4sam-2021.04"
BR2_TARGET_UBOOT_BOARD_DEFCONFIG="sama5d3_xplained_lan937x_mmc"
BR2_PACKAGE_HOST_DOSFSTOOLS=y
BR2_PACKAGE_HOST_GENIMAGE=y
BR2_PACKAGE_HOST_MTOOLS=y
BR2_PACKAGE_HOST_UBOOT_TOOLS=y
BR2_PACKAGE_HOST_UBOOT_TOOLS_ENVIMAGE=y
BR2_PACKAGE_HOST_UBOOT_TOOLS_ENVIMAGE_SOURCE="board/atmel/sama5d3_xplained_lan937x/uboot-env.txt"
BR2_PACKAGE_HOST_UBOOT_TOOLS_ENVIMAGE_SIZE="0x4000"
```

## src/Atmel_SOC_SAMA5D3/buildroot_external_lan937x/package/dt-overlay-mchp/dtbos/sama5d3_eds.its
```
// SPDX-License-Identifier: (GPL-2.0+ OR MIT)
/*
 * sama5d3_eds.its - Flattened Image Tree file for SAMA5D3 Ethernet
 * Development System board
 *
 * Copyright (C) 2022 Microchip Technology, Inc. and its subsidiaries
 * Author: Jerry Ray <jerry.ray@microchip.com>
 *
 */
/dts-v1/;

/ {
	description = "Microchip SAMA5D3-EDS FIT Image";
	#address-cells = <1>;

	images {
		kernel {
			description = "Linux kernel";
			data = /incbin/("./zImage");
			type = "kernel";
			arch = "arm";
			os = "linux";
			compression = "none";
			load = <0x22000000>;
			entry = <0x22000000>;
			hash-1 {
				algo = "crc32";
			};
			hash-2 {
				algo = "sha1";
			};
		};

		base_fdt {
			description = "Flattened Device Tree blob";
			data = /incbin/("./at91-sama5d3_eds.dtb");
			type = "flat_dt";
			arch = "arm";
			compression = "none";
			load = <0x23000000>;
			hash-1 {
				algo = "crc32";
			};
			hash-2 {
				algo = "sha1";
			};
		};

		fdt_lan9370 {
			description = "Device Tree blob lan9370 overlay";
			data = /incbin/("./sama5d3_eds/sama5d3_eds_lan9370.dtbo");
			type = "flat_dt";
			arch = "arm";
			compression = "none";
			load = <0x23120000>;
			hash-1 {
				algo = "crc32";
			};
			hash-2 {
				algo = "sha1";
			};
		};

		fdt_lan9374 {
			description = "Device Tree blob lan9374 overlay";
			data = /incbin/("./sama5d3_eds/sama5d3_eds_lan9374.dtbo");
			type = "flat_dt";
			arch = "arm";
			compression = "none";
			load = <0x23130000>;
			hash-1 {
				algo = "crc32";
			};
			hash-2 {
				algo = "sha1";
			};
		};

		fdt_lan9373_dual {
			description = "Device Tree blob lan9373 Dual-t overlay";
			data = /incbin/("./sama5d3_eds/sama5d3_eds_lan9373_dual.dtbo");
			type = "flat_dt";
			arch = "arm";
			compression = "none";
			load = <0x23140000>;
			hash-1 {
				algo = "crc32";
			};
			hash-2 {
				algo = "sha1";
			};
		};

		fdt_ksz9893 {
			description = "Device Tree blob ksz9893 overlay";
			data = /incbin/("./sama5d3_eds/sama5d3_eds_ksz9893.dtbo");
			type = "flat_dt";
			arch = "arm";
			compression = "none";
			load = <0x23150000>;
			hash-1 {
				algo = "crc32";
			};
			hash-2 {
				algo = "sha1";
			};
		};

		fdt_ksz9477 {
			description = "Device Tree blob ksz9477 overlay";
			data = /incbin/("./sama5d3_eds/sama5d3_eds_ksz9477.dtbo");
			type = "flat_dt";
			arch = "arm";
			compression = "none";
			load = <0x23160000>;
			hash-1 {
				algo = "crc32";
			};
			hash-2 {
				algo = "sha1";
			};
		};

		fdt_ksz9563 {
			description = "Device Tree blob ksz9563 overlay";
			data = /incbin/("./sama5d3_eds/sama5d3_eds_ksz9563.dtbo");
			type = "flat_dt";
			arch = "arm";
			compression = "none";
			load = <0x23170000>;
			hash-1 {
				algo = "crc32";
			};
			hash-2 {
				algo = "sha1";
			};
		};
	};

	configurations {
		default = "kernel_dtb";

		kernel_dtb {
			description = "Linux kernel and base FDT blob for SAMA5D3_EDS board";
			kernel = "kernel";
			fdt = "base_fdt";
		};

		base_dtb {
			description = "FDT blob for the SAMA5D3_EDS base board";
			fdt = "base_fdt";
		};

		lan9370 {
			description = "FDT overlay blob for lan9370 RMII add-on board";
			fdt = "fdt_lan9370";
		};

		lan9374 {
			description = "FDT overlay blob for lan9374 RGMII add-on board";
			fdt = "fdt_lan9374";
		};

		lan9373_dual {
			description = "FDT overlay blob for lan9373 Dual-t RMII add-on board";
			fdt = "fdt_lan9373_dual";
		};

		ksz9893 {
			description = "FDT overlay blob for ksz9893 RGMII add-on board";
			fdt = "fdt_ksz9893";
		};

		ksz9477 {
			description = "FDT overlay blob for ksz9477 RGMII add-on board";
			fdt = "fdt_ksz9477";
		};

		ksz9563 {
			description = "FDT overlay blob for ksz9563 RGMII add-on board";
			fdt = "fdt_ksz9563";
		};
	};
};
```

## src/kernels/masternet-next/Documentation/devicetree/bindings/net/dsa/lan937x.txt
```
Microchip LAN937X series switch support
======================================

Required properties:

- compatible: For external switch chips, compatible string must be exactly one
  of the following:
  - "microchip,lan9370"
  - "microchip,lan9371"
  - "microchip,lan9372"
  - "microchip,lan9373"
  - "microchip,lan9374"

Optional properties:

- reset-gpios		: Should be a gpio specifier for a reset line
- microchip,synclko-125 : Set if the output SYNCLKO frequency should be set to
			  125MHz instead of 25MHz.

See Documentation/devicetree/bindings/net/dsa/dsa.txt for a list of additional
required and optional properties.

Examples:

Ethernet switch connected via SPI to the host, CPU port wired to eth1:

	eth1: ethernet@f802c000 {
		#address-cells = <1>;
		#size-cells = <0>;
		
		fixed-link {
			speed = <100>;
			full-duplex;
		};
	};
	
	spi1: spi@f8008000 {
		cs-gpios = <0>, <0>, <0>, <&pioC 28 0>;
		id = <1>;
		
		lan9370: lan9370@3 {
			compatible = "microchip,lan9370";
			reg = <3>;

			spi-max-frequency = <44000000>;
			spi-cpha;
			spi-cpol;
	
			ports {
				#address-cells = <1>;
				#size-cells = <0>;
				port@0 {
					reg = <0>;
					label = "lan1";
				};
				port@1 {
					reg = <1>;
					label = "lan2";
				};
				port@2 {
					reg = <2>;
					label = "lan3";
				};
				port@3 {
					reg = <3>;
					label = "lan4";
				};
				port@4 {
					reg = <4>;
					label = "cpu";
					ethernet = <&eth1>;
					fixed-link {
						speed = <100>;
						full-duplex;
					};
				};
			};
		};

		lan9371: lan9371@3 {
			compatible = "microchip,lan9371";
			reg = <3>;

			spi-max-frequency = <44000000>;
			spi-cpha;
			spi-cpol;

			ports {
				#address-cells = <1>;
				#size-cells = <0>;
				port@0 {
					reg = <0>;
					label = "lan1";
				};
				port@1 {
					reg = <1>;
					label = "lan2";
				};
				port@2 {
					reg = <2>;
					label = "lan3";
				};
				port@3 {
					reg = <3>;
					label = "lan4";
				};
				port@4 {
					reg = <4>;
					label = "cpu";
					ethernet = <&eth1>;
					fixed-link {
						speed = <100>;
						full-duplex;
					};
				};
				port@5 {
					reg = <5>;
					label = "lan5";
					fixed-link {
						speed = <100>;
						full-duplex;
					};
				};
			};
		};
	};
```
